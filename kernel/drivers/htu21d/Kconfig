## kernel/drivers/htu21d/Kconfig
```kconfig
# SPDX-License-Identifier: GPL-2.0
#
# 状态：implemented（初稿）/ hardware-blocked / UNVERIFIED（未在目标内核编译验证）
# 依据：任务书 CODEX_MASTER_TASK.md §7.2；README（IIO 路线）
config HTU21D_IIO
	tristate "HTU21D humidity/temperature sensor custom IIO driver"
	depends on I2C
	depends on IIO
	help
	  自定义 HTU21D（Si7021 兼容）温湿度 IIO 驱动（初稿，UNVERIFIED）：
	  IIO_TEMP / IIO_HUMIDITYRELATIVE 两通道，read_raw 发起单次测量
	  （no-hold + CRC 校验，失败计数）。

	  注意：主线 hwmon 已有 SENSORS_HTU21（drivers/hwmon/htu21.c，
	  compatible "meas,htu21d"），与本驱动绑定名相同，二者不要同时启用
	  （重复设备绑定风险），见 drivers/htu21d/README。DTS 节点待板卡确定后
	  单独提交，本驱动不含 DTS。
```

## kernel/drivers/mlx90640/Kconfig
```kconfig
# SPDX-License-Identifier: GPL-2.0
#
# 状态：implemented（初稿）/ hardware-blocked / UNVERIFIED（未在目标内核编译验证）
# 依据：任务书 CODEX_MASTER_TASK.md §7.1；README 接口决策（cdev，禁止 miscdevice）
config MLX90640
	tristate "MLX90640 thermal camera custom driver (cdev)"
	depends on I2C
	help
	  自定义 Melexis MLX90640 32x24 红外热成像驱动（初稿，UNVERIFIED）：
	  标准 i2c_driver + 标准字符设备（cdev，非 miscdevice），每次 read 主动
	  采集两个 subpage 并交错合并，温度换算在用户态完成。

	  注意：主线内核的 video-i2c 亦提供 MLX90640 支持（V4L2 路线），二者
	  不要同时绑定同一器件（重复设备绑定风险），见 drivers 目录 README
	  的接口决策与备选评估。DTS 节点待板卡确定后单独提交，本驱动不含 DTS。
```
